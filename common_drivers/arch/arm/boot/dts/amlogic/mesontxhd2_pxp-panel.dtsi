// SPDX-License-Identifier: (GPL-2.0+ OR MIT)
/*
 * Copyright (c) 2019 Amlogic, Inc. All rights reserved.
 */

/ {
	lcd:lcd {
		compatible = "amlogic, lcd-txhd2";
		status = "okay";
		index = <0>;
		pxp = <1>;
		mode = "tablet";
		fr_auto_policy = <0>; /* 0=disable, 1=enable */
		reg = <0xff64c000 0x400   /* mipi_dsi_a host */
			0xff64800 0x200>;   /* mipi_dsi_a phy */
		interrupts = <0 57 1>;
		interrupt-names = "vsync";

		mipi_0{
			model_name = "MIPI-1080P";
			interface = "mipi";
			basic_setting = <1920 1080 /*h_active, v_active*/
				2200 1125 /*h_period, v_period*/
				8 /*lcd_bits*/
				154 86>; /*screen_widht, screen_height*/
			lcd_timing = <44 148 0 /*hs_width, hs_bp, hs_pol*/
				5 36 0>; /*vs_width, vs_bp, vs_pol*/
			clk_attr = <0 0 1 148500000>;
			mipi_attr = <4 900 0 1 0 2 1 0>; /*unused*/

			/* dsi_init: data_type, num, data... */
			dsi_init_on = <0xff 0>; /*ending*/
			dsi_init_off = <0xff 0>; /*ending*/
			extern_init = <0xff>; /*0xff for invalid*/

			/* power step: type, index, value, delay(ms) */
			power_on_step = <
				2 0 0 0
				0xff 0 0 0>; /*ending*/
			power_off_step = <
				2 0 0 50
				0xff 0 0 0>; /*ending*/
			backlight_index = <0xff>;
		};
	};
};
