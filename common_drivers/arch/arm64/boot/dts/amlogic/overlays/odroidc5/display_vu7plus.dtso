/dts-v1/;
/plugin/;

&drm_subsystem {
	display-timings {
		native-mode = <&timing0>;

		fixed-display;

		timing0: 1024x600p78hz_vu7plus {
			clock-frequency = <63500000>;
			hactive = <1024>;
			vactive = <600>;
			hfront-porch = <48>;
			hsync-len = <96>;
			hback-porch = <144>;
			vfront-porch = <3>;
			vsync-len = <10>;
			vback-porch = <11>;
			hsync-active = <0>;
			vsync-active = <1>;
			width_mm = <153>;
			height_mm = <86>;
		};
	};
};

&amhdmitx {
	force_hpd;
	voutmode = "dvi";
};
