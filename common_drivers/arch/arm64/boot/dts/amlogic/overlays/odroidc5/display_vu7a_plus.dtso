/dts-v1/;
/plugin/;

&drm_subsystem {
	display-timings {
		native-mode = <&timing0>;

		fixed-display;

		timing0: 1024x600p60hz_vu7a_plus {
			clock-frequency = <49000000>;
			hactive = <1024>;
			vactive = <600>;
			hfront-porch = <5>;
			hsync-len = <13>;
			hback-porch = <270>;
			vfront-porch = <2>;
			vsync-len = <3>;
			vback-porch = <17>;
			hsync-active = <0>;
			vsync-active = <1>;
			width_mm = <255>;
			height_mm = <255>;
		};
	};
};
