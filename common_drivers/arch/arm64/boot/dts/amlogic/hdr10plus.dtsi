// SPDX-License-Identifier: (GPL-2.0+ OR MIT)
/*
 * Copyright (c) 2019 Amlogic, Inc. All rights reserved.
 */

#include <dt-bindings/display/hdr10plus.h>

&amlvecm {
	enable_hdr10plus = <HDR10PLUS_STATE>;/*1:enable ;0:disable*/
};
