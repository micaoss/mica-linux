## common_drivers/drivers/media/video_processor/Kconfig
```kconfig
# SPDX-License-Identifier: (GPL-2.0+ OR MIT)
#
# Amlogic video processor configuration
#

menu "Amlogic Video Processor Support"

config AMLOGIC_MEDIA_VIDEO_PROCESSOR
	bool "Amlogic Video Processor Driver"
	default n
	help
		Amlogic Video Processor module support,
		such as ION_VIDEO, PPMGR, AML_V4L_VIDEO and etc,
		both of which depends on this
		configuration options.

if AMLOGIC_MEDIA_VIDEO_PROCESSOR
source "$(COMMON_DRIVERS_DIR)/drivers/media/video_processor/pic_dev/Kconfig"

source "$(COMMON_DRIVERS_DIR)/drivers/media/video_processor/ppmgr/Kconfig"
source "$(COMMON_DRIVERS_DIR)/drivers/media/video_processor/utils/Kconfig"
# source "$(COMMON_DRIVERS_DIR)/drivers/media/video_processor/pic_dev/Kconfig"
source "$(COMMON_DRIVERS_DIR)/drivers/media/video_processor/video_dev/Kconfig"
source "$(COMMON_DRIVERS_DIR)/drivers/media/video_processor/v4lvideo/Kconfig"
source "$(COMMON_DRIVERS_DIR)/drivers/media/video_processor/video_composer/Kconfig"
source "$(COMMON_DRIVERS_DIR)/drivers/media/video_processor/videotunnel/Kconfig"
source "$(COMMON_DRIVERS_DIR)/drivers/media/video_processor/videoqueue/Kconfig"
source "$(COMMON_DRIVERS_DIR)/drivers/media/video_processor/common/Kconfig"
source "$(COMMON_DRIVERS_DIR)/drivers/media/video_processor/di_process/Kconfig"
source "$(COMMON_DRIVERS_DIR)/drivers/media/video_processor/dpss_process/Kconfig"
source "$(COMMON_DRIVERS_DIR)/drivers/media/video_processor/buf_manager/Kconfig"
source "$(COMMON_DRIVERS_DIR)/drivers/media/video_processor/videodisplay/Kconfig"
source "$(COMMON_DRIVERS_DIR)/drivers/media/video_processor/v2d/Kconfig"
source "$(COMMON_DRIVERS_DIR)/drivers/media/video_processor/video_pipe_adapter/Kconfig"
endif

endmenu
```

## common_drivers/drivers/media/video_processor/buf_manager/Kconfig
```kconfig
# SPDX-License-Identifier: (GPL-2.0+ OR MIT)

#
# Amlogic buf_manager device configuration
#

menu "Amlogic buf_manager support"

config AMLOGIC_BUF_MANAGER
	tristate "Amlogic buf_manager device support"
	default n

	help
		Select to enable "Amlogic buf_manager device support.

endmenu
```

## common_drivers/drivers/media/video_processor/di_process/Kconfig
```kconfig
# SPDX-License-Identifier: (GPL-2.0+ OR MIT)

#
# Amlogic di_process device configuration
#

menu "Amlogic di_process support"

config AMLOGIC_DI_PROCESS
	tristate "Amlogic di_process device support"
	default n
	select AMLOGIC_BUF_MANAGER
	help
		Select to enable "Amlogic di_process device support.

endmenu
```

## common_drivers/drivers/media/video_processor/dpss_process/Kconfig
```kconfig
# SPDX-License-Identifier: (GPL-2.0+ OR MIT)

#
# Amlogic dpss_process device configuration
#

menu "Amlogic dpss_process support"

config AMLOGIC_DPSS_PROCESS
	tristate "Amlogic dpss_process device support"
	default n
	select AMLOGIC_BUF_MANAGER

	help
		Select to enable "Amlogic dpss_process device support.

config AMLOGIC_DPSS_THERMAL
	tristate "generic dpss cooling support"
	depends on AMLOGIC_COOLDEV
	default n
	help
		This implements change the dpss power state.
		this driver gives apis which indicates thermal info to dpss driver to
		control dpss power.

endmenu
```

## common_drivers/drivers/media/video_processor/v2d/Kconfig
```kconfig
# SPDX-License-Identifier: (GPL-2.0+ OR MIT)

#
# Amlogic v2d device configuration
#

menu "Amlogic v2d support"

config AMLOGIC_MEDIA_V2D
	tristate "Amlogic v2d device support"
	default y

	help
		Select to enable "Amlogic v2d device support.

endmenu
```

## common_drivers/drivers/media/video_processor/v4lvideo/Kconfig
```kconfig
# SPDX-License-Identifier: (GPL-2.0+ OR MIT)

#
# Amlogic v4lvideo device configuration
#

menu "Amlogic v4l video support"

config AMLOGIC_V4L_VIDEO3
	tristate "Amlogic v4l video3 device support"
	depends on VIDEO_DEV
	depends on VIDEOBUF2_CORE
	depends on VIDEOBUF2_MEMOPS
	depends on DMA_SHARED_BUFFER
	default n

	help
		Select to enable "Amlogic v4l video3 device support.

endmenu
```

## common_drivers/drivers/media/video_processor/video_pipe_adapter/Kconfig
```kconfig
# SPDX-License-Identifier: (GPL-2.0+ OR MIT)

#
# Amlogic video_pipe_adapter device configuration
#

menu "Amlogic video_pipe_adapter support"

config AMLOGIC_VIDEO_PIPE_ADAPTER
	tristate "Amlogic video_pipe_adapter device support"
	default n
	help
		Select to enable "Amlogic video_pipe_adapter device support.

endmenu
```

## common_drivers/drivers/media/video_processor/videodisplay/Kconfig
```kconfig
# SPDX-License-Identifier: (GPL-2.0+ OR MIT)

#
# Amlogic videodisplay device configuration
#

menu "Amlogic videodisplay support"

config AMLOGIC_VIDEO_DISPLAY
	tristate "Amlogic videodisplay device support"
#	depends on VIDEO_DEV
	default n

	help
		Select to enable "Amlogic videodisplay device support.

endmenu
```

## common_drivers/drivers/media/vout/eDPTX/Kconfig
```kconfig
# SPDX-License-Identifier: (GPL-2.0+ OR MIT)

#
# Video output configuration
#
menu "Amlogic DisplayPort Output Module"

config AMLOGIC_eDPTX
	bool "DisplayPort Output Module"
	default n
	help
		Support for DisplayPort/eDP output

endmenu
```

## common_drivers/drivers/media/vout/hdmi_tx_connector/Kconfig
```kconfig
# SPDX-License-Identifier: (GPL-2.0+ OR MIT)

#
# TX_CONNECTOR
#
menu "Amlogic TX_CONNECTOR Common Module"

config AMLOGIC_TX_CONNECTOR_COMMON
	bool "AMLOGIC TX_CONNECTOR common"
	default n
	help
	This option is used to configure Amlogic drivers
        of the tx_connector common software part

source "$(COMMON_DRIVERS_DIR)/drivers/media/vout/hdmi_tx_connector/hdmitx/Kconfig"
source "$(COMMON_DRIVERS_DIR)/drivers/media/vout/hdmi_tx_connector/hdcp/Kconfig"

endmenu
```

## common_drivers/drivers/media/vout/hdmi_tx_connector/hdmitx/Kconfig
```kconfig
# SPDX-License-Identifier: (GPL-2.0+ OR MIT)
#
# Amlogic hdmitx driver configuration
#

menu "Amlogic HDMITX Driver"

config AMLOGIC_HDMITX_DRIVER
	bool "AMLOGIC HDMITX DRIVER"
	default n
	select AMLOGIC_TX_CONNECTOR_COMMON
	help
	This option is used to configure Amlogic hdmtix drivers


source "$(COMMON_DRIVERS_DIR)/drivers/media/vout/hdmi_tx_connector/hdmitx/tx21/Kconfig"
source "$(COMMON_DRIVERS_DIR)/drivers/media/vout/hdmi_tx_connector/hdmitx/tx20/Kconfig"
endmenu
```

## common_drivers/drivers/media/vout/hdmi_tx_connector/hdmitx/tx20/Kconfig
```kconfig
# SPDX-License-Identifier: (GPL-2.0+ OR MIT)

#
# HDMITX
#
menu "Amlogic HDMITX Module"

config AMLOGIC_HDMITX
	bool "AMLOGIC HDMITX driver"
	select AMLOGIC_HDMITX_DRIVER
	default n
	help
	This option is used to configure Amlogic drivers
        of the hdmi tx output

config AMLOGIC_HDMITX_GXX
	bool "AMLOGIC HDMITX driver compile"
	depends on !AMLOGIC_REMOVE_OLD
	default AMLOGIC_HDMITX
	help
	This option is used to compile Amlogic drivers
        of the hdmi tx output

endmenu
```

## common_drivers/drivers/media/vout/lcd/lcd_extern/Kconfig
```kconfig
# SPDX-License-Identifier: (GPL-2.0+ OR MIT)


menuconfig AMLOGIC_LCD_EXTERN
	bool "LCD external driver support"
	default n
	help
		Amlogic LCD external driver support, such as i2c initial
		Once the power on, according to the timing requirements,
		through the panel interface to write data to the LCD,
		make its initialization

config AMLOGIC_LCD_EXTERN_I2C_ANX6862_7911
	bool "lcd external i2c ANX6862_7911 init driver"
	default n
	depends on AMLOGIC_LCD_EXTERN
	help
		Amlogic LCD external i2c_ANX6862_7911 init driver support
		Once the power on, according to the timing requirements,
		through the i2c interface to write data to the LCD,
		make its initialization

config AMLOGIC_LCD_EXTERN_I2C_CS602
	bool "lcd external i2c CS602 init driver"
	default n
	depends on AMLOGIC_LCD_EXTERN
	help
		Amlogic LCD external i2c_CS602 init driver support
		Once the power on, according to the timing requirements,
		through the i2c interface to write data to the LCD,
		make its initialization

config AMLOGIC_LCD_EXTERN_I2C_OLED
		bool "lcd external i2c OLED driver"
		default n
		depends on AMLOGIC_LCD_EXTERN
		help
			Amlogic LCD external i2c_oled driver support
			Once the power on, according to the timing requirements,
			through the i2c interface to write data to the LCD,
			make its initialization
```

## common_drivers/drivers/media/vout/meson_tx_connector/Kconfig
```kconfig
# SPDX-License-Identifier: (GPL-2.0+ OR MIT)

#
# TX_CONNECTOR
#
menu "Amlogic TX_CONNECTOR Common Module"

config AMLOGIC_TX_CONNECTOR_COMMON_MODERN
	bool "AMLOGIC TX_CONNECTOR common"
	default n
	help
	This option is used to configure Amlogic drivers
        of the tx_connector common software part

source "$(COMMON_DRIVERS_DIR)/drivers/media/vout/meson_tx_connector/hdmitx/Kconfig"
source "$(COMMON_DRIVERS_DIR)/drivers/media/vout/meson_tx_connector/dptx/Kconfig"
source "$(COMMON_DRIVERS_DIR)/drivers/media/vout/meson_tx_connector/hdcp/Kconfig"
#source "$(COMMON_DRIVERS_DIR)/drivers/media/vout/meson_tx_connector/phy/Kconfig"
#source "$(COMMON_DRIVERS_DIR)/drivers/media/vout/meson_tx_connector/venc/Kconfig"
#source "$(COMMON_DRIVERS_DIR)/drivers/media/vout/meson_tx_connector/clk/Kconfig"

endmenu
```

## common_drivers/drivers/media/vout/meson_tx_connector/dptx/Kconfig
```kconfig
# SPDX-License-Identifier: (GPL-2.0+ OR MIT)
#
# Amlogic dptx driver configuration
#

menu "Amlogic DPTX Driver"

config AMLOGIC_DPTX_DRIVER
	bool "AMLOGIC DPTX DRIVER"
	default n
	select AMLOGIC_TX_CONNECTOR_COMMON_MODERN
	help
	This option is used to configure Amlogic dptx drivers


source "$(COMMON_DRIVERS_DIR)/drivers/media/vout/meson_tx_connector/dptx/dp20/Kconfig"
endmenu
```

## common_drivers/drivers/media/vout/meson_tx_connector/dptx/dp20/Kconfig
```kconfig
# SPDX-License-Identifier: (GPL-2.0+ OR MIT)

#
# DPTX
#
menu "Amlogic DPTX Module"

config AMLOGIC_DPTX
	bool "AMLOGIC DPTX driver"
	select AMLOGIC_DPTX_DRIVER
	default n
	help
	This option is used to configure Amlogic drivers
        of the dp tx output

endmenu
```

## common_drivers/drivers/media/vout/meson_tx_connector/hdcp/Kconfig
```kconfig
# SPDX-License-Identifier: (GPL-2.0+ OR MIT)

#
# TX_HDCP
#
menu "Amlogic TX HDCP Module"

config AMLOGIC_HDCP_TX_MODERN
	bool "AMLOGIC TX_CONNECTOR HDCP"
	default n
	help
	This option is used to configure Amlogic HDCP
        of the tx_connector

endmenu
```

## common_drivers/drivers/media/vout/meson_tx_connector/hdmitx/Kconfig
```kconfig
# SPDX-License-Identifier: (GPL-2.0+ OR MIT)
#
# Amlogic hdmitx driver configuration
#

menu "Amlogic HDMITX Driver"

config AMLOGIC_HDMITX_DRIVER_MODERN
	bool "AMLOGIC HDMITX DRIVER"
	default n
	select AMLOGIC_TX_CONNECTOR_COMMON_MODERN
	help
	This option is used to configure Amlogic hdmtix drivers


source "$(COMMON_DRIVERS_DIR)/drivers/media/vout/meson_tx_connector/hdmitx/tx21/Kconfig"
source "$(COMMON_DRIVERS_DIR)/drivers/media/vout/meson_tx_connector/hdmitx/tx20/Kconfig"
endmenu
```

## common_drivers/drivers/media/vout/meson_tx_connector/hdmitx/tx20/Kconfig
```kconfig
# SPDX-License-Identifier: (GPL-2.0+ OR MIT)

#
# HDMITX
#
menu "Amlogic HDMITX Module"

config AMLOGIC_HDMITX_MODERN
	bool "AMLOGIC HDMITX driver"
	select AMLOGIC_HDMITX_DRIVER_MODERN
	default n
	help
	This option is used to configure Amlogic drivers
        of the hdmi tx output

config AMLOGIC_HDMITX_GXX_MODERN
	bool "AMLOGIC HDMITX driver compile"
	depends on !AMLOGIC_REMOVE_OLD
	default AMLOGIC_HDMITX_MODERN
	help
	This option is used to compile Amlogic drivers
        of the hdmi tx output

endmenu
```

## common_drivers/drivers/media/vout/meson_tx_connector/hdmitx/tx21/Kconfig
```kconfig
# SPDX-License-Identifier: (GPL-2.0+ OR MIT)

#
# HDMITX
#
menu "Amlogic HDMITX Module"

config AMLOGIC_HDMITX21_MODERN
	bool "AMLOGIC HDMITX21 driver"
	default n
	select AMLOGIC_HDMITX_DRIVER_MODERN
	select AMLOGIC_HDCP_TX_MODERN
	help
	This option is used to configure Amlogic drivers
        of the hdmi tx output

endmenu
```

## common_drivers/drivers/memory_debug/cma_debug/Kconfig
```kconfig
# SPDX-License-Identifier: (GPL-2.0+ OR MIT)

config AMLOGIC_CMA_DEBUG
    bool "Amlogic cma debug support"
    depends on !DEBUG_FS && CMA_SYSFS
    default y
    help
      This is the debug interface for cma
```

## common_drivers/drivers/memory_debug/ramdump/Kconfig
```kconfig
# SPDX-License-Identifier: (GPL-2.0+ OR MIT)

config AMLOGIC_RAMDUMP
	bool "Amlogic full ramdump"
	default n
	help
		Amlogic ramump implementation. When kernel pain is
		generated, the entire ddr data will be compressed and
		copied out. Finally, use the crash tool to debug and
		analyze on the PC side.

config AMLOGIC_RAMDUMP_TEXTOFFSET
	bool "set TEXTOFFSET=0x02008000 for kernel 32bit"
	depends on ARM
	depends on AMLOGIC_RAMDUMP
	default n
	help
		The 32-bit kernel cannot use ramdump because the text
		section at 1MB is overwritten by BL2 after reboot.
		Set TEXTOFFSET to 24MB+, just for kernel 32bit.

config AMLOGIC_RAMDUMP_DMA_COPY
	bool "DMA copy 0-24MB after kernel panic"
	depends on ARM
	depends on AMLOGIC_RAMDUMP
	default y if !AMLOGIC_RAMDUMP_TEXTOFFSET
	default n
	help
		The 32-bit kernel cannot use ramdump because the text
		section at 1MB is overwritten by BL2 after reboot.
		DMA copy 0-24MB to high-mem area after kernel panic.
```

## common_drivers/drivers/memory_debug/slub_debug/Kconfig
```kconfig
# SPDX-License-Identifier: (GPL-2.0+ OR MIT)

config AMLOGIC_SLUB_DEBUG
    bool "Amlogic cma debug support"
    depends on !DEBUG_FS
    default y
    help
      This is the debug interface for slub alloc and free
```

## common_drivers/drivers/mtd/spinand/Kconfig
```kconfig
# SPDX-License-Identifier: (GPL-2.0+ OR MIT)

config AMLOGIC_MTD_SPI_NAND
        tristate "AMLOGIC SPI NAND support"
        default n
        depends on SPI_MASTER
        depends on AMLOGIC_BREAK_GKI
        select MTD_NAND_CORE
        select SPI_MEM
        help
          This is based on MTD_SPI_NAND, adding partition and rsv management.
          Say Y, Will register partitions according to dts and add rsv
          management.
          Say N, Only register one mtd device.
```

## common_drivers/drivers/odroid/Kconfig
```kconfig
# SPDX-License-Identifier: (GPL-2.0+ OR MIT)

if ARCH_MESON_ODROID_COMMON

config ODROID_CUSTOM_DISPLAY_MODES
	tristate "ODROID custom display modes"
	default m if ARCH_MESON_ODROIDC5
	default n
	help
	  Provides the ODROID custom display timing registry.  aml_media and
	  aml_drm use this module as the single source for custom timings.

config ODROID_CUSTOM_DISPLAY_MODES_MODELINE_FILE
	bool "Custom display modes from userspace file"
	default y
	depends on ODROID_CUSTOM_DISPLAY_MODES

config ODROID_CUSTOM_DISPLAY_MODES_CMDLINE
	bool "Custom display modes from kernel command line"
	default y
	depends on ODROID_CUSTOM_DISPLAY_MODES

config ODROID_CUSTOM_DISPLAY_MODES_DEVICETREE
	bool "Custom display modes from device tree"
	default y
	depends on ODROID_CUSTOM_DISPLAY_MODES

config ODROID_CUSTOM_DISPLAY_MODES_DEBUGFS
	bool "Custom display modes debugfs dump"
	default y
	depends on ODROID_CUSTOM_DISPLAY_MODES
	depends on DEBUG_FS
	help
	  Exposes /sys/kernel/debug/odroid/custom_display with the custom
	  display modes currently known by the ODROID custom display mode
	  registry.

endif
```
