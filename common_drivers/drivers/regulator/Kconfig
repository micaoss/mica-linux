## common_drivers/drivers/regulator/Kconfig
```kconfig
# SPDX-License-Identifier: (GPL-2.0+ OR MIT)

config AMLOGIC_REGULATOR
	tristate "Amlogic regulator devices support"
	depends on REGULATOR
	default n
	help
	  regulator devices support
	  select y for built-in
	  select m for ko
	  select n for disable

if AMLOGIC_REGULATOR
config AMLOGIC_REGULATOR_PWM
	bool "Amlogic PWM voltage regulator"
	depends on PWM
	help
	  This driver supports PWM controlled voltage regulators. PWM
	  duty cycle can increase or decrease the voltage.

config AMLOGIC_REGULATOR_PWM_MODIFY
	bool "PWM voltage regulator for AMLOGIC define"
	depends on AMLOGIC_REGULATOR_PWM
	help
	  This driver supports some feature of PWM regulators.
	  such as:
	  1. need use regulator to delay dvfs voltage setting;
	  2. deal with problem of voltage by changed to max booting to kernel;

source "$(COMMON_DRIVERS_DIR)/drivers/regulator/meson_pmic6b/Kconfig"
endif
```

## common_drivers/drivers/usb/Kconfig
```kconfig
# SPDX-License-Identifier: GPL-2.0

menu "USB Support"

config AMLOGIC_USB
	bool "Amlogic USB controller support"
	default n
	select USB_PHY if AMLOGIC_BREAK_GKI
	depends on USB
	help
	  DWC_OTG
	  USB
	  host
	  controller.

config AMLOGIC_COMMON_USB
	bool "It is used to cover the USB modification for common dir."
	default n
	depends on AMLOGIC_USB
	help
	  DWC_OTG
	  USB
	  host
	  controller.

config AMLOGIC_USB_SUPPORT
	tristate "USB Host controller and phy support"
	depends on AMLOGIC_USB
	help
	  USB Host
	  controller
	  dwc_otg
	  support

config AMLOGIC_USB_DWC_OTG_HCD
	tristate "USB Host controller dwc_otg support"
	depends on AMLOGIC_USB
	help
	  USB Host
	  controller
	  dwc_otg
	  support

config AMLOGIC_CRG
        bool "USB Host controller corigine support"
        depends on AMLOGIC_USB
        help
          USB Host
          controller
          corigine
          support

config MESON_USBPHY
	bool "Meson new USB PHY Driver"
	depends on AMLOGIC_USB
	help
	  Enable this to support new Amlogic USB phy driver for Amlogic SoCs.
	  This driver uses the Generic Phy framework for Amlogic USB 2.0 PHY &
	  Amlogic USB 3.0 PHY and implements Amlogic USB otg functions.

	  For which socs this driver supports, check the files in the driver directory.

config AMLOGIC_USBPHY
	bool "Amlogic USB PHY Driver"
	depends on AMLOGIC_USB
	help
	  Enable this to support Amlogic USB phy helper driver for Amlogic SoCs.
	  This driver provides common interface to interact, for Amlogic USB 2.0 PHY
	  driver and later for Amlogic USB 3.0 PHY driver.

	  This driver supports GXBABYTV and G9TV.

          To compile this driver as a module, choose M here: the
          module will be called phy-aml-usb.

config AMLOGIC_USB2PHY
	bool "Amlogic USB 2.0 PHY controller Driver"
	depends on AMLOGIC_USBPHY
	help
	  Enable this to support Amlogic USB 2.0 (High Speed) PHY controller
	  for Amlogic SoCs.

	  This driver supports GXBABYTV and G9TV.

	  To compile this driver as a module, choose M here: the
          module will be called phy-aml-usb.

config AMLOGIC_USB3PHY
	bool "Amlogic USB 3.0 PHY controller Driver"
	depends on AMLOGIC_USBPHY
	help
	  Enable this to support Amlogic USB 3.0 (Super Speed) phy controller
	  for Amlogic SoCs.

	  This driver supports GXBABYTV and G9TV.

          To compile this driver as a module, choose M here: the
          module will be called phy-aml-usb.

config AMLOGIC_USBPHYC2
	bool "Amlogic C2 USB PHY controller Driver"
	depends on AMLOGIC_USBPHY
	help
	  Enable this to support Amlogic USB phy controller
	  for Amlogic SoCs.

	  This driver supports GXBABYTV and G9TV.

	  To compile this driver as a module, choose M here: the
	  module will be called phy-aml-usb.

config AMLOGIC_BC
        bool "Amlogic BC detect Driver"
        depends on AMLOGIC_USB
        help
          Enable this to support Amlogic BC detect for Amlogic SoCs.

          This driver supports C2.

          To compile this driver as a module, choose M here: the
          module will be called amlogic-bc.

config AMLOGIC_CC
        bool "Amlogic CC detect Driver"
        depends on AMLOGIC_USB
        help
          Enable this to support Amlogic CC detect for Amlogic SoCs.

          This driver supports C2.

          To compile this driver as a module, choose M here: the
          module will be called amlogic-cc.

config AMLOGIC_USB_DWC3_TRACE
	bool "Used to control to build trace-meson.c"
	depends on USB_DWC3 && TRACING
	default y
	help
	  Used to control to build trace-meson.c

config AMLOGIC_USB_DWC3_HOST
	bool "Used to control to build host-meson.c"
	depends on USB_DWC3 && (USB_DWC3_HOST || USB_DWC3_DUAL_ROLE)
	default y
	help
	  Used to control to build host-meson.c

config AMLOGIC_USB_DWC3_GADGET_AND_EP0
	bool "Used to control to build gadget-meson.c and ep0-meson.c"
	depends on USB_DWC3 && (USB_DWC3_GADGET || USB_DWC3_DUAL_ROLE)
	default y
	help
	  Used to control to build gadget-meson.c and ep0-meson.c

config AMLOGIC_USB_DWC3_DRD
	bool "Used to control to build drd-meson.c"
	depends on USB_DWC3 && USB_DWC3_DUAL_ROLE
	default y
	help
	  Used to control to build drd-meson.c

config AMLOGIC_USB_DWC3_ULPI
	bool "Used to control to build ulpi-meson.c"
	depends on USB_DWC3 && USB_DWC3_ULPI
	default y
	help
	  Used to control to build ulpi-meson.c.

config AMLOGIC_USB_DWC3_DEBUGFS
	bool "Used to control to build debugfs-meson.c"
	depends on USB_DWC3 && DEBUG_FS
	default y
	help
	  Used to control to build debugfs-meson.c.

endmenu
```

## common_drivers/sound/soc/amlogic/auge/vad/Kconfig
```kconfig
config AMLOGIC_SND_SOC_AUGE_VAD
	tristate "Amlogic snd vad"
	default AMLOGIC_SND_SOC
	help
	  Say Y or M if you want to add support for audio arch Auge
	  to the Amlogic Asoc Interface. it is a new audio arch to
	  distinguish Meson audio arch. it is base on kernel 4.9
	  Amlogic New SOC for New Audio ARCH
```
