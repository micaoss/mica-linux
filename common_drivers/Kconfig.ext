## common_drivers/drivers/external/leds/Kconfig
```kconfig
# SPDX-License-Identifier: GPL-2.0-only
#
# RTC class/drivers configuration
#

config LEDS_AW21036
  tristate "LED AW21036 Support"
  default n
  help
    This option enables support for LED AW21036 drivers.
```

## common_drivers/drivers/external/nfc/nta533/Kconfig
```kconfig
# SPDX-License-Identifier: GPL-2.0-only
#
# RTC class/drivers configuration
#

config NFC_NTA533
	tristate "NFC NTA5333 device support"
	default n
	help
	  Say Y here if you want to use the NFC.
```

## common_drivers/drivers/external/sensor/htu20d/Kconfig
```kconfig
# SPDX-License-Identifier: (GPL-2.0+ OR MIT)

config TEMP_HTU20D
 tristate "temperature htu20d sensor"
 default n
 help
   Say Y here if you want to use the light sensor.
```

## common_drivers/drivers/external/sensor/radar/Kconfig
```kconfig
# SPDX-License-Identifier: (GPL-2.0+ OR MIT)

config RADAR_WAKEUP
	tristate "Radar wakeup device support"
	default n
	help
	  Say Y here if you want to use the radar wakeup device.
```

## common_drivers/drivers/external/sensor/ucs11681/Kconfig
```kconfig
# SPDX-License-Identifier: (GPL-2.0+ OR MIT)

config LIGHT_UCS11681
 tristate "light ucs11681 and proximity sensor"
 default n
 help
   Say Y here if you want to use the light sensor.
```

## common_drivers/drivers/external/video/st7789v3_tft/Kconfig
```kconfig
# SPDX-License-Identifier: (GPL-2.0+ OR MIT)

config ST7789V3_TFT_170X320
	tristate "st7789v3 tft 170x320 panel device support"
	default n
	help
	  Say Y here if you want to use the st7789v3 tft 170x320 panel device.
```

## common_drivers/drivers/gki_tool/Kconfig
```kconfig
# SPDX-License-Identifier: (GPL-2.0+ OR MIT)

config AMLOGIC_GKI_TOOL
	tristate "Meson gki tool"
	default n
	help
	  provide common tools for GKI ko,
	  including __setup...

config AMLOGIC_CLASS_DEBUG
	tristate "Amlogic class debug node"
	depends on !DEBUG_FS
	default n
	help
	  tv gki debugfs is default disabled,
	  use /sys/class/debug replace.
```

## common_drivers/drivers/gpio/Kconfig
```kconfig
# SPDX-License-Identifier: (GPL-2.0+ OR MIT)

config AMLOGIC_GPIO
	tristate "Amlogic gpio support"
	default n
	help
	  gpio device support
	  select y for built-in
	  select m for ko
	  select n for disable

if AMLOGIC_GPIO

config AMLOGIC_GPIOLIB
	bool "Amlogic gpiolib expand"
	depends on AMLOGIC_GPIO
	depends on GPIOLIB
	default n
	help
	  Say Y here if you want to use the
	  amlogic gpiolib expand.

config AMLOGIC_GPIOLIB_SYSFS
	bool "Amlogic gpiolib-sysfs"
	depends on AMLOGIC_GPIO
	depends on GPIOLIB
	depends on !GPIO_SYSFS
	default n
	help
	  Say Y here if you want to use the
	  amlogic gpiolib-sysfs-expand. This file is copied
	  from kernel drivers/gpio/ and add some modification.
	  It can not exist with common GPIO_SYSFS.
config AMLOGIC_GPIO_DEBUG
	bool "Amlogic gpio debug function"
	depends on AMLOGIC_GPIO
	depends on !AMLOGIC_ZAPPER_CUT
	default n
	help
	  Say Y here if you want to use the
	  amlogic gpio debug function. This is used to create debug node
	  under debugfs.

source "$(COMMON_DRIVERS_DIR)/drivers/gpio/irqchip/Kconfig"
source "$(COMMON_DRIVERS_DIR)/drivers/gpio/pinctrl/Kconfig"
source "$(COMMON_DRIVERS_DIR)/drivers/gpio/meson_pmic6b/Kconfig"

endif # AMLOGIC_GPIO
```

## common_drivers/drivers/hwspinlock/Kconfig
```kconfig
#
# Amlogic hwspinlock device configuration
#

menu "MESON hw spin lock Support"

config AMLOGIC_HWSPINLOCK
	tristate "MESON HW SPIN LOCK"
	depends on HWSPINLOCK
	help
		MESON HWSPIN LOCK.
		.
		.
		.

endmenu
```

## common_drivers/drivers/i2c/busses/Kconfig
```kconfig
# SPDX-License-Identifier: (GPL-2.0+ OR MIT)

menu "I2C Hardware Bus support"
	depends on HAS_IOMEM

config AMLOGIC_I2C
	tristate "Amlogic Meson I2C controller"
	help
	  If you say yes to this option, support will be included for the
	  I2C interface on the Amlogic Meson family of SoCs.

config AMLOGIC_I2C_MESON
	bool "Amlogic Meson I2C controller"
	depends on AMLOGIC_I2C
	help
	  If you say yes to this option, support will be included for the
	  I2C interface on the Amlogic Meson family of SoCs.

config AMLOGIC_I2C_MESON_T6W
	bool "Amlogic Meson I2C T6W controller"
	depends on AMLOGIC_I2C
	help
	  If you say yes to this option, support will be included for the
	  I2C interface on the Amlogic Meson family of SoCs.

config AMLOGIC_I2C_MESON_V2
	bool "Amlogic Meson I2C V2 controller"
	depends on AMLOGIC_I2C
	help
	  If you say yes to this option, support will be included for the
	  I2C interface on the Amlogic Meson family of SoCs after t6x.

endmenu
```

## common_drivers/drivers/input/misc/Kconfig
```kconfig
# SPDX-License-Identifier: (GPL-2.0+ OR MIT)

config AMLOGIC_INPUT_FILTER
	bool "Amlogic Input Filter support"
	default n
	help
	  Say Y here if you want to use the Input Filter.
```

## common_drivers/drivers/input/watchkey/Kconfig
```kconfig
# SPDX-License-Identifier: (GPL-2.0+ OR MIT)

config AMLOGIC_WATCHKEY
	bool "Amlogic watch key device support"
	default n
	help
	  Watch-Key driver can monitor the status of keys from
	  the beginning of power-on.

	  Say Y here if you want to use the amlogic watch key.
```

## common_drivers/drivers/media/common/media_proxy/Kconfig
```kconfig
#
# media proxy driver configuration
#

menu "MediaProxy driver"

config AMLOGIC_MEDIA_PROXY
	tristate "MediaProxy driver"
	default n
	help
		Select to enable AMLOGIC PROXY driver to
		manage error event
endmenu
```

## common_drivers/drivers/media/common/uvm_process/Kconfig
```kconfig
# SPDX-License-Identifier: (GPL-2.0+ OR MIT)
#
# uvm core configuration
#

config AMLOGIC_UVM_PROCESSOR
	bool "Support to compile the uvm_xx_processor files"
	default AMLOGIC_UVM_CORE
	help
	  support to compile the uvm_xx_processor files.
```

## common_drivers/drivers/media/dtv_demod/Kconfig
```kconfig
# SPDX-License-Identifier: (GPL-2.0+ OR MIT)
#
# DTV driver configuration
#

menu "Amlogic DTV driver"

config AMLOGIC_DTV_DEMOD
	tristate "Amlogic DTVDEMOD device driver"
	default n
	help
		DTVDEMOD device driver.
		Y: enable
		N: disable
		M: build as module

if AMLOGIC_DTV_DEMOD

config AMLOGIC_DEMOD_SUPPORT_DTMB
	bool "Amlogic DTVDEMOD DTMB support"
	depends on !AMLOGIC_ZAPPER_CUT
	default n
	help
		if support DTMB driver.

config AMLOGIC_DEMOD_SUPPORT_ATSC
	bool "Amlogic DTVDEMOD ATSC support"
	depends on !AMLOGIC_ZAPPER_CUT
	default n
	help
		if support ATSC driver.

config AMLOGIC_DEMOD_SUPPORT_ISDBT
	bool "Amlogic DTVDEMOD ISDBT support"
	depends on !AMLOGIC_ZAPPER_CUT
	default n
	help
		if support ISDBT driver.

config AMLOGIC_DEMOD_SUPPORT_DVBT
	bool "Amlogic DTVDEMOD DVBT support"
	depends on !AMLOGIC_ZAPPER_CUT
	default n
	help
		if support DVBT driver.

config AMLOGIC_DEMOD_SUPPORT_J83B
	bool "Amlogic DTVDEMOD J83B support"
	default n
	help
		if support J83B driver.

config AMLOGIC_DEMOD_SUPPORT_DVBS
	bool "Amlogic DTVDEMOD DVBS support"
	default n
	help
		if support DVBS driver.

config AMLOGIC_DEMOD_SUPPORT_DVBC
	bool "Amlogic DTVDEMOD DVBC support"
	default n
	help
		if support DVBC driver.

endif

endmenu
```

## common_drivers/drivers/media/info/Kconfig
```kconfig
# SPDX-License-Identifier: (GPL-2.0+ OR MIT)
#
# Amlogic multimedia information
#
config AMLOGIC_MEDIA_INFO
	bool "Multimedia Information"
	default n
	help
		Amlogic multimedia information support
```
