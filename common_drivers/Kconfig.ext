## common_drivers/Kconfig.ext
```kconfig
# SPDX-License-Identifier: GPL-2.0

menu "Amlogic drivers"
config AMLOGIC_DRIVER
	bool "Amlogic Peripheral drivers"
	default n
	help
	  this option is provided for control amlogic
	  drivers, if you want to use amlogic driver
	  please open it.
	  Note: All amlogic driver should be placed in
	  directory $(COMMON_DRIVERS_DIR)/drivers/

if AMLOGIC_DRIVER
config AMLOGIC_BREAK_GKI_20
	bool "Amlogic Break GKI 2.0"
	default n
	help
	  this option is provide for control Break GKI 2.0,
	  if you want to break gki2.0 rule, should enable it,
	  all break gki2.0 modify should be depends on this option

config AMLOGIC_BREAK_GKI
	bool "Amlogic Break GKI"
	select AMLOGIC_BREAK_GKI_20
	default n
	help
	  this option is provide for control Break GKI,
	  if you want to debug driver temporarily, should enable it,
	  export function or variable with this config,
	  and the driver Kconfig depends on this option

config AMLOGIC_MODIFY
	bool "Amlogic modify for kernel code"
	default n
	help
	  This option is set up for AMLOGIC modify of standard
	  kernel source code. All modify of kernel standard code
	  should be wrapped by this config

config AMLOGIC_IN_KERNEL_MODULES
	bool "Amlogic Drivers in build or extra build"
	default n
	help
	  this option is provided for control amlogic
	  drivers in build or extra build, if you want
	  to in build, should enable; if want to extra
	  build, should disable

config AMLOGIC_KERNEL_VERSION
	int "Amlogic Kernel Version"
	default 16612
	help
	  kernel from android16-6.12
	  so the default value is 16612
	  the driver uses it to adapt different kernel versions

config AMLOGIC_DDK_BUILD
	bool "Amlogic ddk_module build"
	default n
	help
	  this option is provide for control use ddk_module()
	  to build common_drivers's drivers,
	  if you don't enable this, it will use in-tree mode build.

if AMLOGIC_IN_KERNEL_MODULES
source "$(COMMON_DRIVERS_DIR)/drivers/Kconfig"
source "$(COMMON_DRIVERS_DIR)/sound/Kconfig"
source "$(COMMON_DRIVERS_DIR)/samples/Kconfig"
endif

source "$(KCONFIG_PROJECT_PREFIX)Kconfig.ext_modules"
endif

endmenu
```

## common_drivers/arch/arm/configs/meson64_a32_zapper_defconfig
```kconfig
# CONFIG_LOCALVERSION_AUTO is not set
CONFIG_KERNEL_LZO=y
CONFIG_DEFAULT_HOSTNAME="(aml)"
CONFIG_NO_HZ=y
CONFIG_HIGH_RES_TIMERS=y
CONFIG_PREEMPT=y
CONFIG_IRQ_TIME_ACCOUNTING=y
CONFIG_RCU_EXPERT=y
CONFIG_RCU_NOCB_CPU=y
# CONFIG_UTS_NS is not set
# CONFIG_PID_NS is not set
# CONFIG_RD_BZIP2 is not set
# CONFIG_RD_LZMA is not set
# CONFIG_RD_XZ is not set
# CONFIG_RD_LZO is not set
# CONFIG_RD_LZ4 is not set
# CONFIG_RD_ZSTD is not set
CONFIG_BOOT_CONFIG=y
CONFIG_CC_OPTIMIZE_FOR_SIZE=y
CONFIG_AMLOGIC_LINUX_S_OPTIMIZE=y
CONFIG_ARCH_VIRT=y
# CONFIG_CACHE_L2X0 is not set
# CONFIG_ARM_ERRATA_643719 is not set
CONFIG_SMP=y
# CONFIG_SMP_ON_UP is not set
CONFIG_SCHED_MC=y
CONFIG_HZ_250=y
# CONFIG_ARM_MODULE_PLTS is not set
# CONFIG_ATAGS is not set
CONFIG_CPU_FREQ=y
CONFIG_CPU_IDLE=y
CONFIG_ARM_PSCI_CPUIDLE=y
CONFIG_VFP=y
CONFIG_NEON=y
CONFIG_KERNEL_MODE_NEON=y
CONFIG_PM_WAKELOCKS=y
# CONFIG_PM_WAKELOCKS_GC is not set
CONFIG_PM_DEBUG=y
CONFIG_ENERGY_MODEL=y
CONFIG_KPROBES=y
CONFIG_JUMP_LABEL=y
# CONFIG_SECCOMP is not set
# CONFIG_STACKPROTECTOR is not set
CONFIG_LOCK_EVENT_COUNTS=y
CONFIG_MODULES=y
CONFIG_MODULE_UNLOAD=y
CONFIG_MODVERSIONS=y
# CONFIG_BLK_DEBUG_FS is not set
CONFIG_PARTITION_ADVANCED=y
# CONFIG_MSDOS_PARTITION is not set
# CONFIG_EFI_PARTITION is not set
CONFIG_GKI_HIDDEN_DRM_CONFIGS=y
CONFIG_GKI_HIDDEN_GPIO_CONFIGS=y
CONFIG_GKI_HIDDEN_MEDIA_CONFIGS=y
# CONFIG_SLAB_MERGE_DEFAULT is not set
# CONFIG_COMPAT_BRK is not set
CONFIG_CMA=y
CONFIG_CMA_AREAS=6
CONFIG_ANON_VMA_NAME=y
CONFIG_NET=y
CONFIG_UNIX=y
# CONFIG_PCPU_DEV_REFCNT is not set
# CONFIG_WIRELESS is not set
# CONFIG_ETHTOOL_NETLINK is not set
CONFIG_DEVTMPFS=y
CONFIG_ARM_SCPI_PROTOCOL=y
CONFIG_MTD=y
CONFIG_MTD_CMDLINE_PARTS=y
# CONFIG_MTD_OF_PARTS is not set
CONFIG_MTD_BLOCK=y
CONFIG_MTD_RAW_NAND=y
CONFIG_MTD_SPI_NOR=y
# CONFIG_MTD_SPI_NOR_USE_4K_SECTORS is not set
CONFIG_MTD_SPI_NOR_SWP_DISABLE=y
CONFIG_ZRAM=y
CONFIG_BLK_DEV_LOOP=y
CONFIG_BLK_DEV_LOOP_MIN_COUNT=4
CONFIG_BLK_DEV_RAM=y
CONFIG_BLK_DEV_RAM_COUNT=4
CONFIG_BLK_DEV_RAM_SIZE=8192
CONFIG_SCSI=y
# CONFIG_SCSI_PROC_FS is not set
CONFIG_BLK_DEV_SD=y
# CONFIG_BLK_DEV_BSG is not set
CONFIG_INPUT_FF_MEMLESS=y
CONFIG_INPUT_EVDEV=y
# CONFIG_INPUT_KEYBOARD is not set
# CONFIG_INPUT_MOUSE is not set
CONFIG_INPUT_TABLET=y
CONFIG_TABLET_USB_ACECAD=y
CONFIG_TABLET_USB_AIPTEK=y
CONFIG_TABLET_USB_HANWANG=y
CONFIG_TABLET_USB_KBTAB=y
# CONFIG_LEGACY_PTYS is not set
CONFIG_HW_RANDOM=y
# CONFIG_DEVMEM is not set
CONFIG_I2C_CHARDEV=y
# CONFIG_I2C_HELPER_AUTO is not set
CONFIG_SPI=y
CONFIG_SPI_SPIDEV=y
CONFIG_SPMI=y
CONFIG_PINCTRL=y
CONFIG_GPIOLIB=y
CONFIG_POWER_RESET=y
CONFIG_POWER_RESET_SYSCON=y
CONFIG_POWER_RESET_SYSCON_POWEROFF=y
# CONFIG_HWMON is not set
CONFIG_THERMAL=y
CONFIG_THERMAL_EMERGENCY_POWEROFF_DELAY_MS=100
CONFIG_THERMAL_DEFAULT_GOV_POWER_ALLOCATOR=y
CONFIG_THERMAL_GOV_POWER_ALLOCATOR=y
CONFIG_CPU_THERMAL=y
CONFIG_WATCHDOG=y
CONFIG_WATCHDOG_CORE=y
CONFIG_REGULATOR=y
CONFIG_REGULATOR_FIXED_VOLTAGE=y
CONFIG_DRM=y
CONFIG_SOUND=y
CONFIG_SND=y
# CONFIG_SND_SUPPORT_OLD_API is not set
# CONFIG_SND_DRIVERS is not set
# CONFIG_SND_SPI is not set
CONFIG_SND_SOC=y
# CONFIG_HID is not set
# CONFIG_USB_HID is not set
CONFIG_USB_ANNOUNCE_NEW_DEVICES=y
CONFIG_USB_EHCI_HCD=y
CONFIG_USB_DWC3=y
CONFIG_USB_GPIO_VBUS=y
CONFIG_USB_ULPI=y
CONFIG_USB_GADGET=y
CONFIG_USB_SNP_UDC_PLAT=y
CONFIG_USB_BDC_UDC=y
CONFIG_USB_CONFIGFS=y
CONFIG_USB_CONFIGFS_F_FS=y
CONFIG_USB_CONFIGFS_F_MIDI=y
CONFIG_NEW_LEDS=y
CONFIG_LEDS_CLASS=y
CONFIG_LEDS_GPIO=y
CONFIG_RTC_CLASS=y
# CONFIG_RTC_NVMEM is not set
# CONFIG_RTC_INTF_PROC is not set
CONFIG_SW_SYNC=y
CONFIG_DMABUF_HEAPS=y
CONFIG_UIO=y
# CONFIG_VIRTIO_MENU is not set
# CONFIG_VHOST_MENU is not set
CONFIG_STAGING=y
CONFIG_ASHMEM=y
CONFIG_HWSPINLOCK=y
CONFIG_MAILBOX=y
# CONFIG_IOMMU_SUPPORT is not set
CONFIG_PM_DEVFREQ=y
CONFIG_IIO=y
CONFIG_IIO_BUFFER=y
CONFIG_IIO_KFIFO_BUF=y
CONFIG_IIO_TRIGGER=y
CONFIG_PWM=y
CONFIG_RESET_CONTROLLER=y
CONFIG_ANDROID_BINDER_IPC=y
CONFIG_ANDROID_BINDERFS=y
# CONFIG_NVMEM is not set
# CONFIG_DNOTIFY is not set
CONFIG_OVERLAY_FS=y
CONFIG_NTFS3_FS=y
CONFIG_TMPFS=y
CONFIG_TMPFS_POSIX_ACL=y
CONFIG_SQUASHFS=y
CONFIG_PSTORE=y
CONFIG_PSTORE_CONSOLE=y
CONFIG_PSTORE_RAM=y
# CONFIG_NETWORK_FILESYSTEMS is not set
CONFIG_STATIC_USERMODEHELPER=y
CONFIG_STATIC_USERMODEHELPER_PATH=""
CONFIG_LSM=""
CONFIG_INIT_ON_ALLOC_DEFAULT_ON=y
CONFIG_CRYPTO_AES=y
CONFIG_CRYPTO_MD5=y
CONFIG_CRYPTO_SHA256=y
CONFIG_CRYPTO_SHA2_ARM_CE=y
CONFIG_CRYPTO_AES_ARM_CE=y
# CONFIG_CRYPTO_HW is not set
CONFIG_DMA_CMA=y
CONFIG_CMA_SIZE_MBYTES=8
CONFIG_CMA_ALIGNMENT=4
CONFIG_PRINTK_TIME=y
CONFIG_FRAME_WARN=2048
CONFIG_MAGIC_SYSRQ=y
CONFIG_DEBUG_FS=y
CONFIG_PAGE_EXTENSION=y
CONFIG_PANIC_ON_OOPS=y
CONFIG_PANIC_TIMEOUT=5
CONFIG_SCHEDSTATS=y
# CONFIG_RUNTIME_TESTING_MENU is not set
CONFIG_AMLOGIC_DRIVER=y
CONFIG_AMLOGIC_BREAK_GKI=y
CONFIG_AMLOGIC_MODIFY=y
CONFIG_AMLOGIC_IN_KERNEL_MODULES=y
CONFIG_AMLOGIC_SERIAL_MESON=y
CONFIG_AMLOGIC_SERIAL_EARLY_CONSOLE=y
CONFIG_AMLOGIC_SERIAL_MESON_CONSOLE=y
CONFIG_AMLOGIC_COMMON_CLK=y
CONFIG_AMLOGIC_COMMON_CLK_MESON_REGMAP=y
CONFIG_AMLOGIC_COMMON_CLK_MESON_DUALDIV=y
CONFIG_AMLOGIC_COMMON_CLK_MESON_MPLL=y
CONFIG_AMLOGIC_COMMON_CLK_MESON_PHASE=y
CONFIG_AMLOGIC_COMMON_CLK_MESON_PLL=y
CONFIG_AMLOGIC_COMMON_CLK_MESON_SCLK_DIV=y
CONFIG_AMLOGIC_COMMON_CLK_MESON_VID_PLL_DIV=y
CONFIG_AMLOGIC_COMMON_CLK_MESON_CPU_DYNDIV=y
CONFIG_AMLOGIC_MESON_CLK_MEASURE=y
CONFIG_AMLOGIC_CLK_DEBUG=y
CONFIG_AMLOGIC_COMMON_CLK_S1A=y
CONFIG_AMLOGIC_SECMON=y
CONFIG_AMLOGIC_DOLBY_FW=y
CONFIG_AMLOGIC_DRM=y
CONFIG_AMLOGIC_DRM_VPU=y
CONFIG_AMLOGIC_DRM_CUT_HDMI_MODERN=y
CONFIG_AMLOGIC_DRM_USE_ION=y
CONFIG_AMLOGIC_UVM=y
CONFIG_AMLOGIC_UVM_ALLOCATOR=y
CONFIG_AMLOGIC_UVM_CORE=y
CONFIG_AMLOGIC_MEDIA_WRAPPER=y
CONFIG_AMLOGIC_MEDIA_MODULE=y
CONFIG_AMLOGIC_MEDIA_ENABLE=y
CONFIG_AMLOGIC_MEDIA_COMMON=y
CONFIG_AMLOGIC_MEDIA_DRIVERS=y
CONFIG_AMLOGIC_MEDIA_MULTI_DEC=y
CONFIG_AMLOGIC_MEDIA_CANVAS=y
CONFIG_AMLOGIC_MEDIA_GE2D=y
CONFIG_AMLOGIC_ION=y
CONFIG_AMLOGIC_ION_SYSTEM_HEAP=y
CONFIG_AMLOGIC_VPU=y
CONFIG_AMLOGIC_MEDIA_RDMA=y
CONFIG_AMLOGIC_MEDIA_VSYNC_RDMA=y
CONFIG_AMLOGIC_MEDIA_VFM=y
CONFIG_AMLOGIC_MEDIA_CODEC_MM=y
CONFIG_AMLOGIC_MEDIA_SECURITY=y
CONFIG_AMLOGIC_MEDIA_RESMANAGE=y
CONFIG_AMLOGIC_SECURE_DMABUF=y
CONFIG_AMLOGIC_HEAP_CMA=y
CONFIG_AMLOGIC_HEAP_CODEC_MM=y
CONFIG_AMLOGIC_HEAP_SECURE=y
CONFIG_AMLOGIC_MEDIA_SW_SYNC=y
CONFIG_AMLOGIC_MEDIA_PROXY=y
CONFIG_AMLOGIC_VOUT=y
CONFIG_AMLOGIC_VOUT_CLK_SERVE=y
CONFIG_AMLOGIC_VOUT_SERVE=y
CONFIG_AMLOGIC_HDMITX21=y
CONFIG_AMLOGIC_CVBS_OUTPUT=y
CONFIG_AMLOGIC_WSS=y
CONFIG_AMLOGIC_VDAC=y
CONFIG_AMLOGIC_MEDIA_VIDEO=y
CONFIG_AMLOGIC_MEDIA_DEINTERLACE=y
CONFIG_AMLOGIC_MEDIA_VIDEO_PROCESSOR=y
CONFIG_AMLOGIC_MEDIA_ENHANCEMENT=y
CONFIG_AMLOGIC_MEDIA_ENHANCEMENT_VECM=y
CONFIG_AMLOGIC_MEDIA_FRAME_SYNC=y
CONFIG_AMLOGIC_MEDIA_VIN=y
CONFIG_AMLOGIC_MEDIA_TVIN=y
CONFIG_AMLOGIC_MEDIA_VDIN=y
CONFIG_AMLOGIC_MEDIA_VIUIN=y
CONFIG_AMLOGIC_MEDIA_ADC=y
CONFIG_AMLOGIC_CEC=y
CONFIG_AMLOGIC_MEDIA_MSYNC=y
CONFIG_AMLOGIC_DTV_DEMOD=y
CONFIG_AMLOGIC_DEMOD_SUPPORT_J83B=y
CONFIG_AMLOGIC_DEMOD_SUPPORT_DVBS=y
CONFIG_AMLOGIC_DEMOD_SUPPORT_DVBC=y
CONFIG_AMLOGIC_DVB_CORE=y
CONFIG_AMLOGIC_POWER=y
# CONFIG_AMLOGIC_POWER_EE is not set
CONFIG_AMLOGIC_CPU_INFO=y
CONFIG_AMLOGIC_SHOW_CPU_CHIPID=y
CONFIG_AMLOGIC_PM=y
CONFIG_AMLOGIC_GX_SUSPEND=y
CONFIG_AMLOGIC_LEGACY_EARLY_SUSPEND=y
CONFIG_AMLOGIC_GX_REBOOT=y
CONFIG_AMLOGIC_GPIO=y
CONFIG_AMLOGIC_GPIOLIB=y
CONFIG_AMLOGIC_MESON_IRQ_GPIO=y
CONFIG_AMLOGIC_PINCTRL_MESON=y
CONFIG_AMLOGIC_PINCTRL_MESON_S4=y
CONFIG_AMLOGIC_PINCTRL_MESON_S1A=y
CONFIG_AMLOGIC_INPUT=y
CONFIG_AMLOGIC_GPIO_KEY=y
CONFIG_AMLOGIC_MESON_IR=y
CONFIG_AMLOGIC_I2C=y
CONFIG_AMLOGIC_I2C_MESON=y
CONFIG_AMLOGIC_SPI=y
CONFIG_AMLOGIC_SPI_MESON_SPIFC=y
CONFIG_AMLOGIC_SPI_NFC=y
CONFIG_AMLOGIC_TEE=y
CONFIG_AMLOGIC_AMLTEE=y
CONFIG_AMLOGIC_OPTEE=y
CONFIG_AMLOGIC_PWM=m
CONFIG_AMLOGIC_PWM_MESON=y
CONFIG_AMLOGIC_PWM_MESON_TEE=y
CONFIG_AMLOGIC_MESON_CPUFREQ=y
CONFIG_AMLOGIC_EFUSE_UNIFYKEY=y
CONFIG_AMLOGIC_EFUSE=y
CONFIG_AMLOGIC_UNIFYKEY=y
CONFIG_AMLOGIC_EFUSE_BURN=y
CONFIG_AMLOGIC_MHU_MBOX=y
CONFIG_AMLOGIC_JTAG_MESON=y
CONFIG_AMLOGIC_MESON_GXBB_WATCHDOG=y
CONFIG_AMLOGIC_MEMORY_EXTEND=y
CONFIG_AMLOGIC_PAGE_TRACE=y
CONFIG_AMLOGIC_CMA=y
CONFIG_AMLOGIC_MEM_DEBUG=y
CONFIG_AMLOGIC_MEMORY_STAT=y
CONFIG_AMLOGIC_MEMORY_OPT=y
CONFIG_AMLOGIC_PIN_LOCKED_FILE=y
CONFIG_AMLOGIC_MEMORY_SLAB_LARGE=y
CONFIG_AMLOGIC_MEMORY_DEBUG=y
CONFIG_AMLOGIC_REG_ACCESS=y
CONFIG_AMLOGIC_DDR_TOOL=y
CONFIG_AMLOGIC_DDR_BANDWIDTH=y
CONFIG_AMLOGIC_DDR_BANDWIDTH_S1A=y
CONFIG_AMLOGIC_DMC_MONITOR=y
CONFIG_AMLOGIC_DMC_MONITOR_BREAK_GKI=y
CONFIG_AMLOGIC_DMC_MONITOR_S4=y
CONFIG_AMLOGIC_DMC_MONITOR_S1A=y
CONFIG_AMLOGIC_HW_RANDOM_MESON=y
CONFIG_AMLOGIC_SOC_INFO=y
CONFIG_AMLOGIC_RESET_MESON=y
CONFIG_AMLOGIC_RTC=y
CONFIG_AMLOGIC_RTC_DRV_MESON_VRTC=y
CONFIG_AMLOGIC_MESON_RTC=y
CONFIG_AMLOGIC_AMLOGIC_THERMAL=y
CONFIG_AMLOGIC_COOLDEV=y
CONFIG_AMLOGIC_DDR_THERMAL=y
CONFIG_AMLOGIC_DEBUG=y
CONFIG_AMLOGIC_BGKI_DEBUG_MISC=y
CONFIG_AMLOGIC_BOOT_TIME=y
CONFIG_AMLOGIC_DEBUG_HLD=y
# CONFIG_AMLOGIC_DEBUG_MHZ is not set
CONFIG_AMLOGIC_ENV_DEBUG=y
CONFIG_AMLOGIC_ZAPPER_NET_CUT=y
CONFIG_AMLOGIC_ZAPPER_CUT=y
CONFIG_AMLOGIC_ZAPPER_CUT_C1A=y
CONFIG_AMLOGIC_REMOVE_OLD=y
CONFIG_AMLOGIC_DEBUG_IOTRACE=y
CONFIG_AMLOGIC_ARMV8_AARCH32=y
CONFIG_AMLOGIC_ARM_UNWIND=y
CONFIG_AMLOGIC_USB=y
CONFIG_AMLOGIC_COMMON_USB=y
CONFIG_AMLOGIC_USB_SUPPORT=y
CONFIG_AMLOGIC_USB_DWC_OTG_HCD=y
CONFIG_AMLOGIC_CRG=y
CONFIG_AMLOGIC_USBPHY=y
CONFIG_AMLOGIC_USB2PHY=y
CONFIG_AMLOGIC_USB3PHY=y
CONFIG_AMLOGIC_CRYPTO_DMA=y
CONFIG_AMLOGIC_MTD_SPI_NAND=y
CONFIG_AMLOGIC_DVB_CONFIG=y
CONFIG_AMLOGIC_DVB_EXTERN=y
CONFIG_AMLOGIC_DVB_DSM=y
CONFIG_AMLOGIC_DVB_COMPAT=y
CONFIG_AMLOGIC_AUCPU=y
CONFIG_AMLOGIC_SMARTCARD=y
CONFIG_AMLOGIC_DVB_DMX=y
CONFIG_AMLOGIC_LED=y
CONFIG_AMLOGIC_LEDS_FD650=y
CONFIG_AMLOGIC_YAFFS_FS=y
CONFIG_AMLOGIC_REGULATOR=y
CONFIG_AMLOGIC_REGULATOR_PWM=y
CONFIG_AMLOGIC_REGULATOR_PWM_MODIFY=y
CONFIG_AMLOGIC_SND_SOC_CODECS=y
CONFIG_AMLOGIC_SND_CODEC_DUMMY_CODEC=y
CONFIG_AMLOGIC_SND_CODEC_AMLT9015=y
CONFIG_AMLOGIC_SND_SOC=y
CONFIG_AMLOGIC_SND_SOC_AUGE=y
CONFIG_AMLOGIC_SND_SOC_COMMON=y
CONFIG_AMLOGIC_AMAUDIO=y
CONFIG_AMLOGIC_AUDIO_DSP=y
CONFIG_AMLOGIC_AUDIO_INFO=y
```

## common_drivers/arch/arm64/configs/amlogic_gcc64_defconfig
```kconfig
# CONFIG_DEBUG_INFO_BTF is not set
# CONFIG_UAPI_HEADER_TEST is not set
CONFIG_AMLOGIC_BREAK_GKI=y
# CONFIG_MODULE_SIG is not set
CONFIG_AMLOGIC_SERIAL_MESON=y
CONFIG_DEVTMPFS=y
CONFIG_JOYSTICK_XPAD_FF=y
```

## common_drivers/drivers/amfc/Kconfig
```kconfig
config AMLOGIC_AMFC
	tristate "Amlogic AMFC driver"
	default n
	help
		Amlogic AMFC driver for
		Hardware compress/decompress module
		This module can help for speed up
		zram and some other cases which using compress/decompress

choice
	prompt "AMFC soc"
	depends on AMLOGIC_AMFC
	default AMFC_S7D
	help
		select which soc for AMFC related drivers

config AMFC_S7D
	bool "AMFC on S7D"

config AMFC_T6D
	bool "AMFC on T6D"

config AMFC_T6W
	bool "AMFC on T6W"

endchoice

config AMFC_BASE
	hex "io base for decompress kernel"
	default 0xfe024000 if AMFC_S7D
	default 0xfe092000 if AMFC_T6D
	default 0xfe092000 if AMFC_T6W
	default 0xfe024000
	help
		Register base of AMFC for decompress uImage code.

config AMLOGIC_F2FS
	bool "AMLOGIC_F2FS filesystem support"
	depends on AMLOGIC_AMFC
	depends on F2FS_FS_COMPRESSION
	default n
	help
		AMLOGIC_F2FS is an optimzation for using amfc as f2fs compress
		backe-end, which can help to increase io performance on platform.

		If unsure, say N.

config AMFC_DMA_TEST
	bool "amfc dma test case for bandwidth"
	depends on AMLOGIC_AMFC
	default y
	help
		Provide an interface for bandwidth testing.
		the test node: /sys/class/amfc/band_test

source "$(COMMON_DRIVERS_DIR)/drivers/amfc/aml_erofs/Kconfig"
source "$(COMMON_DRIVERS_DIR)/drivers/amfc/aml_zram/Kconfig"
source "$(COMMON_DRIVERS_DIR)/drivers/amfc/sym_helper/Kconfig"
```

## common_drivers/drivers/amfc/sym_helper/Kconfig
```kconfig
config AMLOGIC_SYM_HELPER
	tristate "Amlogic symbol helper"
	depends on AMLOGIC_AMFC
	default n
	help
		Amlogic symbole help driver for modules use gki symbols
```

## common_drivers/drivers/aml_tee/Kconfig
```kconfig
# SPDX-License-Identifier: GPL-2.0-only
# Generic Trusted Execution Environment Configuration
config AMLOGIC_AMLTEE
	tristate "Trusted Execution Environment support"
	depends on HAVE_ARM_SMCCC || COMPILE_TEST || CPU_SUP_AMD
	select CRYPTO if AMLOGIC_BREAK_GKI
	select CRYPTO_SHA1 if AMLOGIC_BREAK_GKI
	select DMA_SHARED_BUFFER if AMLOGIC_BREAK_GKI
	select GENERIC_ALLOCATOR if AMLOGIC_BREAK_GKI
	help
	  This implements a generic interface towards a Trusted Execution
	  Environment (TEE).

if AMLOGIC_AMLTEE

menu "TEE drivers"

source "$(COMMON_DRIVERS_DIR)/drivers/aml_tee/optee/Kconfig"
endmenu

endif
```

## common_drivers/drivers/aml_watermark/Kconfig
```kconfig
# SPDX-License-Identifier: GPL-2.0-only
# Amlogic Watermark Configuration
config AMLOGIC_WATERMARK
	tristate "Amlogic Watermark Support"
	help
	  Amlogic REE Watermark Driver
```

## common_drivers/drivers/camera/Kconfig
```kconfig
# SPDX-License-Identifier: (GPL-2.0+ OR MIT)

config AMLOGIC_MEDIA_CAMERA
	tristate "Amlogic Camera driver"
	select VIDEOBUF2_DMA_CONTIG if AMLOGIC_BREAK_GKI
	select VIDEOBUF2_VMALLOC if AMLOGIC_BREAK_GKI
	select V4L2_FWNODE if AMLOGIC_BREAK_GKI
	select V4L2_ASYNC if AMLOGIC_BREAK_GKI
	default n
	help
		This option is used to configure amlogic camera driver,
		which need use dma contig and v4l2 fwnode.
		select y for built-in
		select m for ko
		select n for disable
```

## common_drivers/drivers/dvb_usbci/Kconfig
```kconfig
#
# Amlogic USBCAM configuration
#
config AMLOGIC_USBCAM
	tristate "amlogic usbcam driver"
	default n
	help
                select it to support amlogic usbcam driver.
```
